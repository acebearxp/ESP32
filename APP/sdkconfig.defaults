## APP/sdkconfig.defaults
```kconfig
CONFIG_IDF_TARGET="esp32s3"
CONFIG_ESPTOOLPY_FLASHSIZE_8MB=y
CONFIG_PARTITION_TABLE_CUSTOM=y

CONFIG_ESP_DEFAULT_CPU_FREQ_MHZ_80=y
CONFIG_SPIRAM=y
CONFIG_SPIRAM_MODE_OCT=y

CONFIG_FREERTOS_USE_TRACE_FACILITY=y

CONFIG_BT_ENABLED=y
CONFIG_BT_BLUEDROID_ENABLED=n
CONFIG_BT_NIMBLE_ENABLED=y
CONFIG_BT_NIMBLE_PINNED_TO_CORE_1=y

CONFIG_ESP_WIFI_TASK_PINNED_TO_CORE_0=y
CONFIG_ESP_COEX_SW_COEXIST_ENABLE=n
CONFIG_LWIP_LOCAL_HOSTNAME="AceBear-ESP32S3"
```

## components/BlinkStatus/Kconfig
```kconfig
menu "BlinkStatus"
    config BLINK_STATUS_DIN_GPIO
        int "The GPIO which RGB LED connected"
        range 0 48
        default 48
        help
            ESP32-S3-DevKitC-1 connect DIN of SK68xx to GPIO48
            22~25 not available
            26~37 for SPI flash and PSRAM, not recommended for using

    config BLINK_STATUS_RMT_CH
        int "RMT TX default channel for sending data to SK68xx"
        range 0 3
        default 2
        help
            Which RMT TX channel is used for sending data
    
    choice BLINK_STATUS_TIMER
        prompt "The timer for blinking"
        default BLINK_STATUS_TIMER_ESP

        config BLINK_STATUS_TIMER_ESP
            bool "ESP High Resolution Timer"
        config BLINK_STATUS_TIMER_GPT
            bool "General Purpose Timer"
    endchoice

    config BLINK_STATUS_TIMER_GPT_GROUP
        int "The group of general purpose timer"
        depends on BLINK_STATUS_TIMER_GPT
        default 0
        range 0 1
        help
            Which general purpose timer is used for blinking
    
    config BLINK_STATUS_TIMER_GPT_INDEX
        int "The index of general purpose timer"
        depends on BLINK_STATUS_TIMER_GPT
        default 0
        range 0 1
        help
            Which general purpose timer is used for blinking

    choice BLINK_STATUS_TIMER_GPT_CLK_SRC
        prompt "The clock source for general purpose timer"
        depends on BLINK_STATUS_TIMER_GPT
        default BLINK_STATUS_TIMER_GPT_CLK_SRC_XTAL
        help
            Choose for timer's clock source

        config BLINK_STATUS_TIMER_GPT_CLK_SRC_APB
            bool "APB[80MHz|CPU_CLK]"
        config BLINK_STATUS_TIMER_GPT_CLK_SRC_XTAL
            bool "XTAL[40MHz]"
    endchoice

    config BLINK_STATUS_TIMER_GPT_CLK_SRC
        int
        depends on BLINK_STATUS_TIMER_GPT_CLK_SRC_APB || BLINK_STATUS_TIMER_GPT_CLK_SRC_XTAL
        default 0 if BLINK_STATUS_TIMER_GPT_CLK_SRC_APB
        default 1 if BLINK_STATUS_TIMER_GPT_CLK_SRC_XTAL

    config BLINK_STATUS_TIMER_GPT_DIVIDER
        int "The divider for general purpose timer"
        depends on BLINK_STATUS_TIMER_GPT
        range 2 65536
        default 40000
        help
            Clock divider
    
endmenu
```

## components/CS100A/Kconfig
```kconfig
menu "CS100A"
    config CS100A_TRIG_US
        int "The high level time that trigger transmit(in us)"
        range 5 200
        default 50
        help
            Should greater than 10us, usually 50us
    
    config CS100A_ECHO_MAX_MS
        int "The longest time waiting for echo(in ms)"
        range 100 5000
        default 2000
endmenu
```

## components/SK68xx/Kconfig
```kconfig
menu "SK68xx"
    config SK68XX_T0HI_NANO_SECONDS
        int "Bit 0 code, high level time, in nano seconds"
        range 200 400
        default 350
        help
            The standard value is 320, should >=200 and <= 400
    
    config SK68XX_T0LO_NANO_SECONDS
        int "Bit 0 code, low level time, in nano seconds"
        range 800 2000
        default 1000
        help
            should >= 800
    
    config SK68XX_T1HI_NANO_SECONDS
        int "Bit 1 code, high level time, in nano seconds"
        range 620 1000
        default 1000
        help
            The standard value is 640, should >=620 and <= 1000
    
    config SK68XX_T1LO_NANO_SECONDS
        int "Bit 1 code, low level time, in nano seconds"
        range 200 2000
        default 350
        help
            should >= 200
    
    config SK68XX_TRST_NANO_SECONDS
        int "Reset code , low level time, in nano seconds"
        range 8000 80000
        default 10000
        help
            should >= 8000
endmenu
```
